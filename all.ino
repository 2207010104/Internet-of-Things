#include <Wire.h>
#include <U8g2lib.h>
#include <ESP8266WiFi.h> // ESP8266专用Wi-Fi库
#include <Servo.h> // 舵机控制
#include <ESP8266WebServer.h> // Web服务器
#include <SoftwareSerial.h>

#define BAUD_RATE 9600

//face
// 初始化U8g2库
U8G2_SSD1306_128X64_NONAME_F_HW_I2C u8g2(U8G2_R0, U8X8_PIN_NONE);

// Wi-Fi设置
const char* ssid = "find5";       // Wi-Fi SSID
const char* password = "88888888"; // Wi-Fi 密码


// 定义多个位图数据
const unsigned char bitmap1[] PROGMEM = {
  // 位图1数据
  0x00,0x00,0x00,0x00,0x00,0x00,0x00,0x00,0x00,0x00,0x00,0x00,0x00,0x00,0x00,0x00,
0x00,0x00,0x00,0x00,0x00,0x00,0x00,0x00,0x00,0x00,0x00,0x00,0x00,0x00,0x00,0x00,
0x00,0x00,0x00,0x00,0x00,0x00,0x00,0x00,0x00,0x00,0x00,0x00,0x00,0x00,0x00,0x00,
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0x00,0x00,0x00,0x00,0x00,0x00,0x00,0x00,0x00,0x00,0x00,0x00,0x00,0x00,0x00,0x00
};
 
const unsigned char bitmap2[] PROGMEM = {
  // 位图2数据
  0x00,0x00,0x00,0x00,0x00,0x00,0x00,0x00,0x00,0x00,0x00,0x00,0x00,0x00,0x00,0x00,
  0x00,0x00,0x00,0x00,0x00,0x00,0x00,0x00,0x00,0x00,0x00,0x00,0x00,0x00,0x00,0x00,
  0x00,0x00,0x00,0x00,0x00,0x00,0x00,0x00,0x00,0x00,0x00,0x00,0x00,0x00,0x00,0x00,
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  0x00,0x00,0x00,0x00,0x00,0x00,0x00,0x00,0x00,0x00,0x00,0x00,0x00,0x00,0x00,0x00
};
 
const unsigned char bitmap3[] PROGMEM = {
  0x00,0x00,0x00,0x00,0x00,0x00,0x00,0x00,0x00,0x00,0x00,0x00,0x00,0x00,0x00,0x00,
0x00,0x00,0x00,0x00,0x00,0x00,0x00,0x00,0x00,0x00,0x00,0x00,0x00,0x00,0x00,0x00,
0x00,0x00,0x00,0x00,0x00,0x00,0x00,0x00,0x00,0x00,0x00,0x00,0x00,0x00,0x00,0x00,
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0x00,0x00,0x00,0x00,0x00,0x00,0x00,0x00,0x00,0x00,0x00,0x00,0x00,0x00,0x00,0x00
};

const unsigned char* bitmaps[] = {bitmap1, bitmap2, bitmap3};
// 定义每个动作的显示时间（毫秒）
unsigned long displayTimes[] = {100, 100, 1000}; // 自定义时间数组
 
int currentBitmapIndex = 0;
bool isCarouselActive = false;
unsigned long lastSwitchTime = 0;

// 修改点：任何命令都会触发完整轮播
void processCommand(String cmd) {
  // 无论收到什么命令都启动轮播
  currentBitmapIndex = 0;      // 从第一个位图开始
  lastSwitchTime = millis();   // 重置计时器
  Serial.println("[INFO] Triggered carousel by command");
}

void updateDisplay() {
  u8g2.clearBuffer();
  u8g2.drawXBMP(0, 0, 128, 64, bitmaps[currentBitmapIndex]);
  u8g2.sendBuffer();
}


// Web服务器设置
ESP8266WebServer server(80);

// HTML页面内容
void handleRoot() {
  String html = "<!DOCTYPE html>\n"
                "<html lang=\"en\">\n"
                "<head>\n"
                "<meta charset=\"UTF-8\">\n"
                "<style>\n"
                "body {\n"
                "  display: flex;\n"
                "  flex-direction: column;\n"
                "  justify-content: center;\n"
                "  align-items: center;\n"
                "  height: 100vh;\n"
                "  margin: 0;\n"
                "  font-family: Arial, sans-serif;\n"
                "}\n"
                ".button-container {\n"
                "  text-align: center;\n"
                "  width: 100%;\n"
                "  max-width: 300px;\n"
                "}\n"
                ".button {\n"
                "  display: block;\n"
                "  padding: 10px 20px;\n"
                "  font-size: 16px;\n"
                "  font-weight: bold;\n"
                "  text-align: center;\n"
                "  color: #fff;\n"
                "  background-color: #007BFF;\n"
                "  border: none;\n"
                "  border-radius: 5px;\n"
                "  cursor: pointer;\n"
                "  margin: 10px 0;\n"
                "}\n"
                ".button:hover {\n"
                "  background-color: #0056b3;\n"
                "}\n"
                ".button:active {\n"
                "  background-color: #004085;\n"
                "}\n"
                "a {text-decoration: none;}\n"
                "</style>\n"
                "</head>\n"
                "<body>\n"
                "<div class=\"button-container\">\n"
                "<h2>WIFI控制开关</h2>\n"
                "<a href=\"/up\" class=\"button\">立正</a>\n"
                "<a href=\"/sq\" class=\"button\">蹲下</a>\n"
                "<a href=\"/ha\" class=\"button\">握手</a>\n"
                "<a href=\"/fw\" class=\"button\">前进</a>\n"
                "<a href=\"/bw\" class=\"button\">后退</a>\n"
                "<a href=\"/ps\" class=\"button\">暂停</a>\n"
                "</div>\n"
                "</body>\n"
                "</html>\n";
  server.send(200, "text/html", html);
}

//语音模块
//asr pro 引脚
SoftwareSerial asrSerial(D5, D6); // RX=D5, TX=D6


// 舵机设置
Servo servo1; // 右上腿
Servo servo2; // 左上腿
Servo servo3; // 右下腿
Servo servo4; // 左下腿

// 定义语音命令
const String cmdSquat = "SQUAT DOWN";
const String cmdHand = "SHAKE HANDS";
const String cmdForward = "GO FORWARD";
const String cmdBackward = "GO BACK";
const String cmdStand = "STAND UP";
const String cmdPause = "STOP";


// 运动控制标志
bool isMoving = false;
unsigned long previousMillis = 0;
const long interval = 200;  // 步态间隔时间（毫秒）
int step = 0;               // 当前步态阶段
bool isForward = true;      // 前进或后退标志



// 单独控制指定舵机
void controlServo(int servoNum, int angle) {
  switch (servoNum) {
    case 1: servo1.write(angle); break;
    case 2: servo2.write(angle); break;
    case 3: servo3.write(angle); break;
    case 4: servo4.write(angle); break;
  }
}

//回正步态
void handleStandup(){
  isMoving = false;
  controlServo(1, 90);
  controlServo(2, 90);
  controlServo(3, 90);  
  controlServo(4, 90);    
  server.sendHeader("Location", "/");
  server.send(303);
}

// 前进步态控制
void handleForward() {
  isMoving = true;
  isForward = true;  // 设置为前进模式
  server.sendHeader("Location", "/");
  server.send(303);
}

// 后退步态控制
void handleBackward() {
  isMoving = true;
  isForward = false;  // 设置为后退模式
  server.sendHeader("Location", "/");
  server.send(303);
}

// 暂停控制
void handlePause() {
  isMoving = false;
  // 停止时恢复中立位置
  controlServo(1, 90);
  controlServo(2, 90);
  controlServo(3, 90);
  controlServo(4, 90);
  server.sendHeader("Location", "/");
  server.send(303);
}

// 四足步态逻辑
void moveLegs() {
  if (!isMoving) return;

  unsigned long currentMillis = millis();
  if (currentMillis - previousMillis >= interval) {
    previousMillis = currentMillis;

    if (isForward) {
      // 前进步态逻辑
      switch (step % 4) {
        case 0:  // 左腿前摆
          controlServo(2, 135);  // 左上腿前摆
          controlServo(4, 45);   // 左下腿后缩
          break;
        case 1:  // 左腿落地，右腿抬起
          controlServo(2, 90);
          controlServo(4, 90);
          controlServo(1, 45);   // 右上腿后缩
          controlServo(3, 135);  // 右下腿前摆
          break;
        case 2:  // 右腿前摆
          controlServo(1, 135);
          controlServo(3, 45);
          break;
        case 3:  // 复位准备下一步
          controlServo(1, 90);
          controlServo(3, 90);
          break;
      }
    } else {
      // 后退步态逻辑
      switch (step % 4) {
        case 0:  // 右腿前摆
          controlServo(1, 135);  // 右上腿前摆
          controlServo(3, 45);   // 右下腿后缩
          break;
        case 1:  // 右腿落地，左腿抬起
          controlServo(1, 90);
          controlServo(3, 90);
          controlServo(2, 45);   // 左上腿前摆
          controlServo(4, 135);  // 左下腿后缩
          break;
        case 2:  // 左腿前摆
          controlServo(2, 135);
          controlServo(4, 45);
          break;
        case 3:  // 复位准备下一步
          controlServo(2, 90);
          controlServo(4, 90);
          break;
      }
    }
    step++;
  }
}

// 控制后腿蹲下
void handleSquat() {
  isMoving = false;
  controlServo(1, 90);
  controlServo(2, 90);
  controlServo(3, 180);  // 右后腿弯曲
  controlServo(4, 0);    // 左后腿弯曲
  server.sendHeader("Location", "/");
  server.send(303);
}

// 握手
void handleHand() {
  isMoving = false;
  controlServo(1, 90);
  controlServo(2, 180); // 右前腿向前
  controlServo(3, 90);
  controlServo(4, 90);
  server.sendHeader("Location", "/");
  server.send(303);
}

// 初始化函数
void setup() {
  Serial.begin(115200); // 用于调试输出
  asrSerial.begin(9600);

  u8g2.begin();
  updateDisplay();
  
  // 初始化四个舵机（分别连接D5-D8）
  servo1.attach(D3, 500, 2500);
  servo2.attach(D4, 500, 2500);
  servo3.attach(D7, 500, 2500);
  servo4.attach(D8, 500, 2500);

  // 设置初始位置
  controlServo(1, 90);
  controlServo(2, 90);
  controlServo(3, 90);
  controlServo(4, 90);

  // 连接Wi-Fi
  WiFi.begin(ssid, password);
  //check wi-fi is connected to wi-fi network
  while (WiFi.status() != WL_CONNECTED) {
  delay(1000);
  Serial.print(".");
  }
  Serial.println("");
  Serial.println("WiFi connected..!");
  Serial.print("Got IP: ");  Serial.println(WiFi.localIP());


  // 配置Web服务器路由
  server.on("/", handleRoot);
  server.on("/up", handleStandup);    //回正
  server.on("/sq", handleSquat);
  server.on("/ha", handleHand);
  server.on("/fw", handleForward); // 前进
  server.on("/bw", handleBackward);  // 后退
  server.on("/ps", handlePause);    // 暂停
  server.begin();
  Serial.println("HTTP server started");
}

// 主循环函数
void loop() {

  // 处理Web服务器请求
  server.handleClient();

  // 执行四足步态逻辑
  moveLegs();

  String command;
  // 修改为检查asrSerial
  if (asrSerial.available() > 0) {
    command = asrSerial.readStringUntil('\n');
    command.trim();
    command.toUpperCase();//转换成大写
    
    Serial.print("[ASR] Received: ");
    Serial.println(command);

    //轮播
    isCarouselActive = true;
    processCommand(command);
    
    // 更健壮的命令检测
    if (command.indexOf(cmdForward) != -1) {
      Serial.println("Executing FORWARD");
      handleForward();
    } 
    else if (command.indexOf(cmdPause) != -1) {
      Serial.println("Executing PAUSE");
      handlePause();
    }
    else if (command.indexOf(cmdSquat) != -1) {
      Serial.println("Executing SQUAT");
      handleSquat();
    }
    else if (command.indexOf(cmdHand) != -1) {
      Serial.println("Executing HAND");
      handleHand();
    }
    else if (command.indexOf(cmdStand) != -1) {
      Serial.println("Executing Stand");
      handleStandup();
    }
    else if (command.indexOf(cmdBackward) != -1) {
      Serial.println("Executing Backword");
      handleBackward();
    }
    else {
      Serial.println("Unknown command");
    }
  }
  if(isCarouselActive){
    if (millis() - lastSwitchTime > displayTimes[currentBitmapIndex]) {
      currentBitmapIndex = (currentBitmapIndex + 1) % (sizeof(bitmaps)/sizeof(bitmaps[0]));
      updateDisplay();
      lastSwitchTime = millis();
      
      // 所有位图播放完成后停止轮播
      if(currentBitmapIndex == 0 && lastSwitchTime > 0){
        isCarouselActive = false;
        Serial.println("[INFO] Carousel finished");
      }
    }
    }
    else {
    // 非轮播状态保持第一个位图
    currentBitmapIndex = 0;  // 强制归位
    updateDisplay();
  }
  
  delay(200); // 每秒更新一次数据
}
